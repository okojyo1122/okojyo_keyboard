## boards/shields/okojyo_keyboard/Kconfig.defconfig
```kconfig
if SHIELD_OKOJYO_KEYBOARD_RIGHT

config ZMK_KEYBOARD_NAME
    default "okojyo_keyboard"

endif

if SHIELD_OKOJYO_KEYBOARD_LEFT || SHIELD_OKOJYO_KEYBOARD_RIGHT

config ZMK_SPLIT
    default y

endif
```

## boards/shields/okojyo_keyboard/Kconfig.shield
```kconfig
config SHIELD_OKOJYO_KEYBOARD_LEFT
    def_bool $(shields_list_contains,okojyo_keyboard_left)
config SHIELD_OKOJYO_KEYBOARD_RIGHT
    def_bool $(shields_list_contains,okojyo_keyboard_right)
```
